## build/boards/cv180x/cv1801b_y24_spinand/cv1801b_y24_spinand_defconfig
```kconfig
CONFIG_CHIP_cv1801b=y
CONFIG_BOARD_y24_spinand=y
CONFIG_DDR_CFG_ddr3_1866_x16=y
CONFIG_ARCH="riscv"
CONFIG_CROSS_COMPILE="riscv64-unknown-linux-gnu-"
CONFIG_TOOLCHAIN_GLIBC_RISCV64=y
# CONFIG_TOOLCHAIN_MUSL_RISCV64=y
CONFIG_CC_OPTIMIZE_FOR_SIZE=y
CONFIG_KERNEL_ENTRY_HACK=y
CONFIG_KERNEL_ENTRY_HACK_ADDR="0x80200000"
CONFIG_FLASH_SIZE_SHRINK=y
CONFIG_BOOT_IMAGE_SINGLE_DTB=y
CONFIG_STORAGE_TYPE_spinand=y
CONFIG_SENSOR_TUNING_PARAM_cv180x_src_gcore_gc4653=n
CONFIG_SENSOR_GCORE_GC2053=n
CONFIG_SENSOR_GCORE_GC2053_1L=n
CONFIG_SENSOR_GCORE_GC2093=n
CONFIG_SENSOR_GCORE_GC4653=n
CONFIG_SENSOR_PIXELPLUS_PR2020=n
CONFIG_SENSOR_SONY_IMX307=n
CONFIG_SENSOR_SONY_IMX327=n
CONFIG_UBOOT_2021_10=y
CONFIG_KERNEL_SRC_5.10=y
CONFIG_KERNEL_LZMA=y
CONFIG_KERNEL_UNCOMPRESSED=n
CONFIG_SKIP_RAMDISK=y
# CONFIG_ROOTFS_OVERLAYFS is not set
# CONFIG_TARGET_PACKAGE_CVITRACER is not set
# CONFIG_TARGET_PACKAGE_GDBSERVER is not set
# CONFIG_TARGET_PACKAGE_OTASERVER is not set
# CONFIG_TARGET_PACKAGE_RSYSLOG is not set
# CONFIG_TARGET_PACKAGE_CRONTABS is not set
# CONFIG_TARGET_PACKAGE_GATORD is not set
CONFIG_TARGET_PACKAGE_DROPBEAR=y
#CONFIG_ENABLE_ALIOS=y
CONFIG_ENABLE_RTOS_DUMP_PRINT=y
CONFIG_DUMP_PRINT_SZ_IDX=17
CONFIG_C906L_DMA_ENABLE=n

# alios not enable
CONFIG_ENABLE_ALIOS=n
# CONFIG_FAST_SOLUTION=y
# CONFIG_RTOS_INIT_MEDIA=y
# CONFIG_RTOS_PARSE_PARAM=y
# CONFIG_MEDIA_SUPPORT_PROC=y

# alios with 256 byte headers record size of yoc.bin
# CONFIG_MIRROR_2ND_PACK_HEAD=n

#CONFIG_UBOOT_SPL_CUSTOM=y
# enable adb
CONFIG_TARGET_PACKAGE_ADBD=y
CONFIG_TARGET_PACKAGE_LIBCRYPTO=y
CONFIG_TARGET_PACKAGE_LIBZ=y

# wifi_tools
CONFIG_TARGET_PACKAGE_WIFI=y
CONFIG_TARGET_PACKAGE_IPERF3=y

# bl602 firmare
CONFIG_TARGET_PACKAGE_BL602_FW=y

# uboot spl
CONFIG_UBOOT_SPL_CUSTOM=y

# ab & recovery
CONFIG_AB_SYSTEM=n
CONFIG_RECOVERY_FS=y
```

## build/boards/cv180x/cv1801b_y24_spinand/u-boot/cvitek_cv1801b_y24_spinand_defconfig
```kconfig
CONFIG_RISCV=y
CONFIG_SYS_MALLOC_F_LEN=0x100000
CONFIG_NR_DRAM_BANKS=1
CONFIG_DEFAULT_DEVICE_TREE="cv180x_asic"
CONFIG_IDENT_STRING=" cvitek_cv180x"
CONFIG_ARCH_RV64I=y
CONFIG_RISCV_SMODE=y
CONFIG_TARGET_CVITEK_CV180X=y
CONFIG_DISTRO_DEFAULTS=y
CONFIG_FIT=y
# CONFIG_ARCH_FIXUP_FDT_MEMORY is not set
CONFIG_BOOTDELAY=0
CONFIG_SYS_PROMPT="cv180x_c906# "
# CONFIG_CMD_CONSOLE is not set
# CONFIG_CMD_XIMG is not set
# CONFIG_CMD_EDITENV is not set
# CONFIG_CMD_CRC32 is not set
# CONFIG_CMD_LZMADEC is not set
# CONFIG_CMD_UNLZ4 is not set
# CONFIG_CMD_UNZIP is not set
# CONFIG_CMD_LOADS is not set
CONFIG_CMD_MMC=y
# CONFIG_CMD_ITEST is not set
CONFIG_CMD_CACHE=y
CONFIG_CMD_CVI_SD_UPDATE=y
# CONFIG_ISO_PARTITION is not set
# CONFIG_EFI_PARTITION is not set
CONFIG_NET_RANDOM_ETHADDR=y
CONFIG_MMC=y
CONFIG_MMC_SDHCI=y
CONFIG_MMC_SDHCI_SDMA=y
CONFIG_MMC_SDHCI_CVITEK=y
CONFIG_MTD=y
# CONFIG_SPI_FLASH is not set
# CONFIG_PHY_SMSC is not set
CONFIG_DM_ETH=y
CONFIG_ETH_DESIGNWARE=y
CONFIG_PHY_CVITEK=y
CONFIG_SYS_NS16550=y
CONFIG_SPI=y
CONFIG_LZ4=y
CONFIG_LZMA=y
# CONFIG_TOOLS_LIBCRYPTO is not set

CONFIG_MTD_RAW_NAND=y
CONFIG_NAND_FLASH_CVSNFC_V3=y
CONFIG_ENV_IS_IN_NAND=y

# boot mode
CONFIG_CMD_BOOT_MODE=y

# uboot spl
CONFIG_TIMER=y
CONFIG_SPL_SIZE_LIMIT=0x100000
CONFIG_SPL_LIBCOMMON_SUPPORT=y
CONFIG_SPL_LIBGENERIC_SUPPORT=y
CONFIG_SPL=y
CONFIG_SUPPORT_SPL=y
CONFIG_SPL_OS_BOOT=y
CONFIG_SPL_MTD_SUPPORT=y
CONFIG_SPL_DM=y
CONFIG_SPL_DM_MMC=y
CONFIG_SPL_FIT=y
CONFIG_SPL_LOAD_FIT=y
CONFIG_SPL_BUILD=y
CONFIG_SPL_SERIAL_SUPPORT=y
CONFIG_SPL_FRAMEWORK_BOARD_INIT_F=y
CONFIG_DEBUG_UART=n
CONFIG_SPL_OPENSBI=n
CONFIG_SPL_LZMA=y
CONFIG_SPL_LZ4=n
CONFIG_SPL_RISCV_SMODE=y
CONFIG_SPL_OF_CONTROL=y
CONFIG_SPL_OF_PLATDATA=n
CONFIG_SPL_TIMER=y
CONFIG_SPL_NAND_SUPPORT=y
CONFIG_SPL_NAND_BASE=y
CONFIG_SPL_NAND_DRIVERS=y
CONFIG_SPL_NAND_ECC=y
CONFIG_SPL_RISCV=y
CONFIG_CMD_SPL_BOOTM=y
CONFIG_SPL_ENV_SUPPORT=y
CONFIG_BINMAN_FDT=n


# for spl boot a/b/recovery
CONFIG_SYS_BOOT_RAMDISK_HIGH=y
CONFIG_SPL_GZIP=y
CONFIG_CMD_ELF=n
CONFIG_BOOTM_EFI=n

# ubi ubifs
CONFIG_MTD_UBI=y
CONFIG_CMD_UBI=y
CONFIG_CMD_UBIFS=n
CONFIG_CMD_MTDPARTS=y
CONFIG_MTD_PARTITIONS=y
CONFIG_RBTREE=y
CONFIG_LZO=y
CONFIG_SPL_UBI=n

# check bad block while burning
CONFIG_CMD_NAND=y
CONFIG_CMD_NAND_TORTURE=y
CONFIG_CMD_REPAIR_NAND=y
```
